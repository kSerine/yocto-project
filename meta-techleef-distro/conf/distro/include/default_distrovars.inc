## meta-techleef-distro/conf/distro/techleef-distro.conf
```bitbake
DISTRO = "techleef-distro"
DISTRO_NAME = "techleef-Distro (Techleef Custom Embedded Linux Distro)"
DISTRO_VERSION = "1.0"
DISTRO_CODENAME = "scarthgap" 

########################control distro features#################
# check https://docs.yoctoproject.org/ref-manual/features.html#distro-features
DISTRO_FEATURES:remove = "acl alsa bluetooth ipv4 ipv6 pcmcia usbgadget usbhost xattr nfs zeroconf pci 3g nfc x11 seccomp pulseaudio sysvinit gobject-introspection-data ldconfig"
##########################default lib and package classes#######
TCLIB = "musl"
PACKAGE_CLASSES ?= " package_ipk"

#########################control init manager###################
TECHLEEF_INIT_MANAGER:techleef-distro = "systemd"
#systemd isn't suitable with musl
TECHLEEF_INIT_MANAGER:techleef-distro:libc-musl = "sysvinit"
INIT_MANAGER ?= "${TECHLEEF_INIT_MANAGER}"

#########################Enable CVE check########################
INHERIT += "cve-check"
include cve-extra-exclusions.inc

#######################Enable build info#########################
INHERIT += "image-buildinfo"


#################Disable GPLv3 packages for all images###########
#still to check it 
#INCOMPATIBLE_LICENSE = "GPLv3"
```
